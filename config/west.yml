## config/west.yml
```yaml
manifest:
  remotes:
    - name: zmkfirmware
      url-base: https://github.com/zmkfirmware
    - name: kureyakey
      url-base: https://github.com/kureyakey
    - name: caksoylar
      url-base: https://github.com/caksoylar
    - name: tkk00
      url-base: https://github.com/tkk00
    - name: kot149
      url-base: https://github.com/kot149

  projects:
    - name: zmk
      remote: zmkfirmware
      revision: v0.2.1
      import: app/west.yml
    - name: zmk-pmw3610-driver
      remote: tkk00
      revision: scroll-acceleration-feature
    - name: zmk-rgbled-widget
      remote: caksoylar
      revision: main
    - name: zmk-scroll-snap
      remote: kot149
      revision: v1
  self:
    path: config
```
